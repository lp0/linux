## Documentation/devicetree/bindings/watchdog/brcm,bcm6345-wdt.txt
```
BCM6345 Watchdog timer

Required properties:

- compatible: should be "brcm,bcm63<soc>-wdt", "brcm,bcm6345-wdt"
- reg: Specifies base physical address and size of the registers.
- clocks: Specify the clock used for timing

Optional properties:

- interrupt-parent: phandle to the interrupt controller
- interrupts: Specify the interrupt used for the watchdog timout warning
- timeout-sec: Contains the default watchdog timeout in seconds

Example:

watchdog {
	compatible = "brcm,bcm63168-wdt", "brcm,bcm6345-wdt";
	reg = <0x1000009c 0x0c>;
	clocks = <&periph_clk>;

	interrupt-parent = <&timer>;
	interrupts = <3>;
	timeout-sec = <30>;
};

watchdog {
	compatible = "brcm,bcm6318-wdt", "brcm,bcm6345-wdt";
	reg = <0x10000068 0x0c>;
	clocks = <&periph_clk>;

	interrupt-parent = <&timer>;
	interrupts = <3>;
	timeout-sec = <30>;
};
```

## Documentation/devicetree/bindings/watchdog/brcm,bcm63xx-wdt.txt
```
BCM63xx Watchdog timer

Required properties:

- compatible : should be "brcm,bcm63xx-wdt"
- reg : Specifies base physical address and size of the registers.
- clocks : Specify the clock used for timing

Optional properties:

- interrupt-parent: phandle to the timer device node
- interrupts: Specify the timer interrupt number
- timeout-sec   : Contains the default watchdog timeout in seconds

Example:

watchdog {
	compatible = "brcm,bcm63xx-wdt";
	reg = <0x1000009c 0x0c>;
	clocks = <&periph_clk>;

	interrupt-parent = <&timer>;
	interrupts = <3>;
	timeout-sec = <30>;
};
```

## arch/mips/bmips/Kconfig
```kconfig
if BMIPS_GENERIC

choice
	prompt "Built-in device tree"
	help
	  Legacy bootloaders do not pass a DTB pointer to the kernel, so
	  if a "wrapper" is not being used, the kernel will need to include
	  a device tree that matches the target board.

	  The builtin DTB will only be used if the firmware does not supply
	  a valid DTB.

config DT_NONE
	bool "None"

config DT_BCM93384WVG
	bool "BCM93384WVG Zephyr CPU"
	select BUILTIN_DTB

config DT_BCM93384WVG_VIPER
	bool "BCM93384WVG Viper CPU (EXPERIMENTAL)"
	select BUILTIN_DTB

config DT_BCM96368MVWG
	bool "BCM96368MVWG"
	select BUILTIN_DTB

config DT_BCM9EJTAGPRB
	bool "BCM9EJTAGPRB"
	select BUILTIN_DTB

config DT_BCM97125CBMB
	bool "BCM97125CBMB"
	select BUILTIN_DTB

config DT_BCM97346DBSMB
	bool "BCM97346DBSMB"
	select BUILTIN_DTB

config DT_BCM97358SVMB
	bool "BCM97358SVMB"
	select BUILTIN_DTB

config DT_BCM97360SVMB
	bool "BCM97360SVMB"
	select BUILTIN_DTB

config DT_BCM97362SVMB
	bool "BCM97362SVMB"
	select BUILTIN_DTB

config DT_BCM97420C
	bool "BCM97420C"
	select BUILTIN_DTB

config DT_BCM97425SVMB
	bool "BCM97425SVMB"
	select BUILTIN_DTB

config DT_BCM97435SVMB
	bool "BCM97435SVMB"
	select BUILTIN_DTB

endchoice

choice
	prompt "Support early printk on UART"
	help
	  Configure the kernel to use a specific CPU's UART for early printk.

config BMIPS_EP_NONE
	bool "None"

config BMIPS_EP_BCM3368_UART0
	bool "BCM3368 UART0"
	select BMIPS_EP_BCM63XX_UART

config BMIPS_EP_BCM3368_UART1
	bool "BCM3368 UART1"
	select BMIPS_EP_BCM63XX_UART

config BMIPS_EP_BCM6338_UART0
	bool "BCM6338/6345/6348 UART0"
	select BMIPS_EP_BCM63XX_UART

config BMIPS_EP_BCM6328_UART0
	bool "BCM6318/6328/6362/6368/6816 UART0"
	select BMIPS_EP_BCM63XX_UART

config BMIPS_EP_BCM6328_UART1
	bool "BCM6328/6362/6368/6816 UART1"
	select BMIPS_EP_BCM63XX_UART

config BMIPS_EP_BCM6358_UART0
	bool "BCM6358 UART0"
	select BMIPS_EP_BCM63XX_UART

config BMIPS_EP_BCM6358_UART1
	bool "BCM6358 UART1"
	select BMIPS_EP_BCM63XX_UART

config BMIPS_EP_BCM63168_UART0
	bool "BCM63168/63268/68220 UART0"
	select BMIPS_EP_BCM63XX_UART

config BMIPS_EP_BCM63168_UART1
	bool "BCM63168/63268/68220 UART1"
	select BMIPS_EP_BCM63XX_UART

endchoice

config BMIPS_EP_BCM63XX_UART
	bool
	select SYS_HAS_EARLY_PRINTK

config BMIPS_EP_BCM63XX_UART_BASE
	hex
	default 0xfff8c100 if BMIPS_EP_BCM3368_UART0
	default 0xfff8c120 if BMIPS_EP_BCM3368_UART1
	default 0xb0000100 if BMIPS_EP_BCM6328_UART0
	default 0xb0000120 if BMIPS_EP_BCM6328_UART1
	default 0xfffe0300 if BMIPS_EP_BCM6338_UART0
	default 0xfffe0100 if BMIPS_EP_BCM6358_UART0
	default 0xfffe0120 if BMIPS_EP_BCM6358_UART1
	default 0xb0000180 if BMIPS_EP_BCM63168_UART0
	default 0xb00001a0 if BMIPS_EP_BCM63168_UART1

endif
```
