## Documentation/devicetree/bindings/clock/brcm,bcm6345-gate-clk.txt
```
Broadcom BCM6345 clocks

This binding uses the common clock binding:
	Documentation/devicetree/bindings/clock/clock-bindings.txt

The BCM6345 contains clocks gated with a register. Clocks are indexed
by bits in the register and are active high. Clock gate bits are
interleaved with other status bits and configurable clocks in the same
register.

Required properties:
- compatible:	Should be "brcm,bcm<soc>-gate-clk", "brcm,bcm6345-gate-clk"
- #clock-cells:	Should be <1>.
- regmap:	The register map phandle
- offset:	Offset in the register map for the reboot register (in bytes)
- clocks:	The external oscillator clock phandle

Example:

periph_clk: periph_clk {
	compatible = "brcm,bcm63168-gate-clk", "brcm,bcm6345-gate-clk";
	regmap = <&periph_cntl>;
	offset = <0x4>;

	#clock-cells = <1>;
	clock-indices =
		<1>,          <2>,        <3>,       <4>,     <5>,
		<6>,          <7>,        <8>,       <9>,     <10>,
		<11>,         <12>,       <13>,      <14>,    <15>,
		<16>,         <17>,       <18>,      <19>,    <20>,
		<27>,         <31>;
	clock-output-names =
		"vdsl_qproc", "vdsl_afe", "vdsl",    "mips",  "wlan_ocp",
		"dect",       "fap0",     "fap1",    "sar",   "robosw",
		"pcm",        "usbd",     "usbh",    "ipsec", "spi",
		"hsspi",      "pcie",     "phymips", "gmac",  "nand",
		"tbus",       "robosw250";
};

timer_clk: timer_clk {
	compatible = "brcm,bcm63168-gate-clk", "brcm,bcm6345-gate-clk";
	regmap = <&timer_cntl>;
	offset = <0x4>;

	#clock-cells = <1>;
	clock-indices = <17>, <18>;
	clock-output-names = "uto_extin", "usb_ref";
};

ehci0: usb@10002500 {
	compatible = "brcm,bcm63168-ehci", "brcm,bcm6345-ehci", "generic-ehci";
	reg = <0x10002500 0x100>;
	big-endian;
	interrupt-parent = <&periph_intc>;
	interrupts = <10>;
	clocks = <&periph_clk 13>, <&timer_clk 18>;
	phys = <&usbh>;
};
```

## Documentation/devicetree/bindings/dma/brcm,bcm63xx-iudma.txt
```
* BCM63xx IUDMA controller

The BCM63xx IUDMA controller has 8, 16 or 32 channels, with one IRQ
per channel.

This is shared by different peripherals which will all provide their
own IUDMA interface registers but with only the channels and IRQs
they require (indexed from 0).

Supported chip variants:
	8 channels: 6345
	16 channels: 3368, 6338, 6348, 6358
	32 channels: 6318, 6328, 6368, 63168, 63268, 6816, 68280

Required properties:
- compatible: Should be "brcm,bcm<chip>-iudma".
- reg: Should contain the IUDMA registers location and length.
- interrupts: Should contain the IUDMA interrupts associated
		with the IUDMA channels in channel ID order.
- #dma-cells: Must be <1>, the cell in the dmas property of the
		client device represents the DMA channel.

Optional properties:
- dma-channels: Should contain the number of channels.
- dma-requests: Should contain the maximum number of buffers to allow
		in the receive/transmit rings.

Example:

enetdma0: dma-controller@1000d800 {
	compatible = "brcm,bcm63168-iudma";
	reg = <0x1000d800 0x600>;
	interrupt-parent = <&periph_intc>;
	interrupts = <1>, <64>, <2>, <65>, <3>, <66>, <4>, <67>;
	#dma-cells = <1>;
	dma-channels = <8>;
	dma-requests = <512>;
};

DMA clients connected to the BCM63xx IUDMA controller must use the format
described in the dma.txt file, using a two-cell specifier for each channel.

Example:

enetsw0: ethernet@10700000 {
	compatible = "brcm,bcm63168-enetsw";
	reg = <0x10700000 0x10000>;
	interrupt-parent = <&periph_intc>;
	interrupts = <48>;
	clocks = <&periph_clk 10>;
	reset = <&periph_soft_rst 4>;
	power-supply = <&power_robosw>;
	dmas = <&enetdma0 0	/* read channel */
		&enetdma0 1>;	/* write channel */
	dma-names = "rx", "tx";
	brcm,phy-ids = <1>, <2>, <3>, <4>;
	brcm,port-names = "fe2", "fe3", "fe4", "fe1";
};
```

## Documentation/devicetree/bindings/interrupt-controller/brcm,bcm63xx-timer.txt
```
Broadcom BCM63xx-style Level 2 timer interrupt controller

This block is a timer controller that is connected to one interrupt on the L1
controller and functions as an interrupt controller for timers.

- 3 independent timers with their own maskable level interrupt bit (but not
  per CPU because there is only one parent interrupt and the timers share it)

- 1 watchdog timer with and unmaskable level interrupt

- Contains one enable/status word pair

- No atomic set/clear operations

The lack of per CPU ability of timers makes them unusable as a set of
clockevent devices, otherwise they could be attached to the remaining
interrupts.

Required properties:

- compatible: should be "brcm,bcm63xx-timer"
- reg: specifies the base physical address and size of the registers;
  the number of supported IRQs is fixed at 4
- interrupt-controller: identifies the node as an interrupt controller
- #interrupt-cells: specifies the number of cells needed to encode an interrupt
  source, should be 1.
- interrupt-parent: specifies the phandle to the parent interrupt controller(s)
  this one is cascaded from
- interrupts: specifies the interrupt line(s) in the interrupt-parent controller
  node; valid values depend on the type of parent interrupt controller

Example:

timer: timer@0x10000080 {
        compatible = "brcm,bcm63xx-timer";
        reg = <0x10000080 0x0c>;

        interrupt-controller;
        #interrupt-cells = <1>;

        interrupt-parent = <&periph_intc>;
        interrupts = <0>;
        clocks = <&periph_clk>;
};
```

## Documentation/devicetree/bindings/net/brcm,bcm63xx-enetsw.txt
```
* BCM63xx Ethernet Switch

The BCM63xx Ethernet Switch has up to 8 physical ports, and a virtual
port representing the host itself. It uses the BCM63xx IUDMA controller
to send/receive packets.

Required properties:
- compatible: Should be "brcm,bcm<chip>-enetsw", "brcm,bcm63xx-enetsw".
- reg: Should contain the enetsw registers location and length.
- clocks: Should contain the clocks required for operation.
- reset: Should contain the reset controller device for soft reset.
- power-supply: Should contain the regulator required to power the chip.
- dmas: Should contain two DMA channels, one for RX and one for TX.
- dma-names: Should be "rx" and "tx" for the RX and TX channels.
- brcm,phy-ids: Should contain the hardware PHY IDs for up to 8 ports
      in the order they are present on the hardware.
- brcm,port-names: Should contain the names of the ports in the same
      order as the brcm,phy-ids. Use an empty port name for ports
      that should be ignored. These will be disabled and not forward
      traffic.

Optional properties:
- interrupts: Should contain the interrupt to use for PHY status changes.

Example:

enetsw0: ethernet@10700000 {
	compatible = "brcm,bcm63168-enetsw", "brcm,bcm63xx-enetsw";
	reg = <0x10700000 0x10000>;
	interrupt-parent = <&periph_intc>;
	interrupts = <48>;
	clocks = <&periph_clk 10>;
	reset = <&periph_soft_rst 4>;
	power-supply = <&power_robosw>;
	dmas = <&enetdma0 0	/* read channel */
		&enetdma0 1>;	/* write channel */
	dma-names = "rx", "tx";
	brcm,phy-ids = <1>, <2>, <3>, <4>;
	brcm,port-names = "fe2", "fe3", "fe4", "fe1";
};
```

## Documentation/devicetree/bindings/phy/brcm,bcm63xx-usbh.txt
```
* Broadcom USBH PHY for BCM63xx

The BCM63xx contains an USB host PHY that must be enabled and configured
for use with the EHCI/OHCI drivers.

Required properties:
- compatible: should be "brcm,bcm<soc>-usbh" followed by one of
	"brcm,bcm6318-usbh" (for BCM6318)
	"brcm,bcm6328-usbh" (for BCM6328, BCM63168, BCM63268, BCM6828, BCM68220)
	"brcm,bcm6358-usbh" (for BCM6358)
	"brcm,bcm6362-usbh" (for BCM6362, BCM6368, BCM6816)

- reg: register range for the PHY interface
- reg-names: should be "phy"
- clocks: list of phandles to the two clocks for the PHY
- clock-names: should be "usbh", "usb_ref"
- resets: phandle to the reset controller for the PHY
- phy-cells: generic PHY binding; must be 0

Example:

usbh: usbphy@10002700 {
	compatible = "brcm,bcm63168-usbh", "brcm,bcm6328-usbh";
	reg = <0x10002700 0x38>;
	clocks = <&periph_clk 13>, <&timer_clk 18>;
	clock-names = "usbh", "usb_ref";
	resets = <&periph_soft_rst 6>;
	power-supply = <&usbh_power>;
	#phy-cells = <0>;
};
```

## Documentation/devicetree/bindings/power/brcm,bcm6358-power-controller.txt
```
Broadcom BCM6358 Power domain controller

This binding uses the power domain bindings:
        Documentation/devicetree/bindings/power/power_domain.txt

The BCM6358 contains power domains controlled with a register. Power
domains are indexed by bits in the register. Power domain bits can be
interleaved with other status bits and clocks in the same register.

Newer SoCs with dedicated power domain registers are active low.

Required properties:
- compatible:           Should be either:
				"brcm,bcm<soc>-power-controller", "brcm,bcm6358-power-controller"
			or (for newer SoCs with dedicated power domain
			registers that are active low):
				"brcm,bcm<soc>-power-controller", "brcm,bcm6328-power-controller"
- #power-domain-cells:  Should be <1>.
- regmap:               The register map phandle
- offset:               Offset in the register map for the power domain register (in bytes)
- power-domain-indices: The bits in the register used for power domains.
- power-domain-names:   Should be a list of strings of power domain names
                        indexed by the power domain indices.

Example:

misc_iddq_ctrl: power-controller {
	compatible = "brcm,bcm63168-power-controller", "brcm,bcm6328-power-controller";
	regmap = <&misc>;
	offset = <0x4c>;

	#power-domain-cells = <1>;
	power-domain-indices =
	                <0>,         <1>,      <2>,    <3>,         <4>,
	                <5>,         <6>,      <7>,    <8>,         <9>,
	                <10>,        <11>,     <12>,   <13>,        <17>,
	                <18>;
	power-domain-names =
	                "sar",       "ipsec",  "mips", "dect",      "usbh",
	                "usbd",      "robosw", "pcm",  "periph",    "vdsl_phy",
	                "vdsl_mips", "fap",    "pcie", "wlan_pads", "gphy",
	                "gmac";
};

periph_iddq: power-controller {
	compatible = "brcm,bcm6368-power-controller", "brcm,bcm6358-power-controller";
	regmap = <&periph_cntl>;
	offset = <0x4>;

	#power-domain-cells = <1>;
	power-domain-indices = <19>;
	power-domain-names = "usbh";
};
```

## Documentation/devicetree/bindings/regulator/brcm,bcm6345-regulator.txt
```
Broadcom BCM6345 regulator

The BCM6345 has one or more registers with bits that act as regulators
to enable/disable power to individual chip peripherals.

Required properties:
- compatible: Must be "brcm,bcm<soc>-regulator", "brcm,bcm6345-regulator";
- regmap: regmap phandle to use for enable control
- offset: register offset
- mask: register enable mask
- startup-delay-us: startup time in microseconds

Any property defined as part of the core regulator
binding, defined in regulator.txt, can also be used.

However the regulator is expected to have the same values
for regulator-min-microvolt and regulator-max-microvolt.

Example:

misc: syscon@10001800 {
	compatible = "syscon";
	reg = <0x10001800 0xd0>;
};

robosw_power: robosw {
	compatible = "brcm,bcm63168-regulator", "brcm,bcm6345-regulator";
	regulator-name = "robosw_power";
	regmap = <&misc>;
	offset = <0x4c>;
	mask = <0x40>;
	startup-delay-us = <100000>;
};
```

## Documentation/devicetree/bindings/reset/brcm,bcm6345-reset.txt
```
Broadcom BCM6345 reset controller

The BCM6345 contains a basic soft reset controller in the perf register
set which resets components using a bit in a register.

Please also refer to reset.txt in this directory for common reset
controller binding usage.

Required properties:
- compatible:	Should be "brcm,bcm<soc>-reset", "brcm,bcm6345-reset"
- regmap:	The register map phandle
- offset:	Offset in the register map for the reset register (in bytes)
- #reset-cells:	Must be set to 1

Example:

periph_soft_rst: reset-controller {
	compatible = "brcm,bcm63168-reset", "brcm,bcm6345-reset";
	regmap = <&periph_cntl>;
	offset = <0x10>;

	#reset-cells = <1>;
};

usbh: usb-phy@10002700 {
	compatible = "brcm,bcm63168-usbh", "brcm,bcm6328-usbh";
	reg = <0x10002700 0x38>;
	clocks = <&periph_clk 13>, <&timer_clk 18>;
	resets = <&periph_soft_rst 6>;
	power-domains = <&misc_iddq_ctrl 4>;
	#phy-cells = <0>;
};
```

## Documentation/devicetree/bindings/timer/brcm,bcm6318-timer.txt
```
Broadcom BCM6318 Timer

This block is a timer that is connected to multiple interrupts on the main
interrupt controller and functions as a programmable interrupt controller for
timer events. There is a main timer interrupt for all timers.

- 4 independent timers with their own interrupt, and own maskable level
  interrupt bit in the main timer interrupt

- 1 watchdog timer with an unmaskable level interrupt bit in the main timer
  interrupt

- Contains one enable/status word pair

- No atomic set/clear operations

Required properties:

- compatible: should be "brcm,bcm<soc>-timer", "brcm,bcm6318-timer"
- reg: specifies the base physical address and size of the registers, excluding
  the watchdog registers
- interrupt-controller: identifies the node as an interrupt controller
- #interrupt-cells: specifies the number of cells needed to encode an interrupt
  source, should be 1.
- interrupt-parent: specifies the phandle to the parent interrupt controller(s)
  this one is cascaded from
- interrupts: specifies the interrupt line(s) in the interrupt-parent controller
  node for the main timer interrupt, followed by the individual timer
  interrupts; valid values depend on the type of parent interrupt controller
- clocks: phandle of timer reference clock (periph)

Example:

timer: timer@10000040 {
	compatible = "brcm,bcm63148-timer", "brcm,bcm6318-timer";
	reg = <0x10000040 0x28>;

	interrupt-controller;
	#interrupt-cells = <1>;

	interrupt-parent = <&periph_intc>;
	interrupts = <31>, <0>, <1>, <2>, <3>;
	clock = <&periph_osc>;
};
```

## Documentation/devicetree/bindings/timer/brcm,bcm6345-timer.txt
```
Broadcom BCM6345 Timer

This block is a timer that is connected to one interrupt on the main interrupt
controller and functions as a programmable interrupt controller for timer
events.

- 3 independent timers with their own maskable level interrupt bit (but not
  per CPU because there is only one parent interrupt and the timers share it)

- 1 watchdog timer with an unmaskable level interrupt

- Contains one enable/status word pair

- No atomic set/clear operations

The lack of per CPU ability of timers makes them unusable as a set of
clockevent devices, otherwise they could be attached to the remaining
interrupts.

Required properties:

- compatible: should be "brcm,bcm<soc>-timer", "brcm,bcm6345-timer"
- reg: specifies the base physical address and size of the registers, excluding
  the watchdog registers
- interrupt-controller: identifies the node as an interrupt controller
- #interrupt-cells: specifies the number of cells needed to encode an interrupt
  source, should be 1.
- interrupt-parent: specifies the phandle to the parent interrupt controller(s)
  this one is cascaded from
- interrupts: specifies the interrupt line(s) in the interrupt-parent controller
  node for the timer interrupt; valid values depend on the type of parent
  interrupt controller
- clocks: phandle of timer reference clock (periph)

Example:

timer: timer@10000080 {
	compatible = "brcm,bcm63168-timer", "brcm,bcm6345-timer";
	reg = <0x10000080 0x1c>;

	interrupt-controller;
	#interrupt-cells = <1>;

	interrupt-parent = <&periph_intc>;
	interrupts = <0>;
	clock·=·<&periph_osc>;
};
```
